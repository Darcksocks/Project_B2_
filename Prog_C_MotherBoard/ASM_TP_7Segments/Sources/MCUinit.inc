;** ###################################################################
;**     This code is generated by the Device Initialization Tool.
;**     It is overwritten during code generation.
;**     USER MODIFICATION ARE PRESERVED ONLY INSIDE EXPLICITLY MARKED SECTIONS.
;**
;**     Project     : DeviceInitialization
;**     Processor   : MC9S08QE8CLC
;**     Version     : Component 01.003, Driver 01.08, CPU db: 3.00.049
;**     Datasheet   : MC9S08QE8RM Rev. 3 1/2008
;**     Date/Time   : 2017-05-29, 12:30, # CodeGen: 5
;**     Abstract    :
;**         This module contains device initialization code 
;**         for selected on-chip peripherals.
;**     Contents    :
;**         Function "MCU_init" initializes selected peripherals
;**
;**     Copyright : 1997 - 2012 Freescale, Inc. All Rights Reserved.
;**     
;**     http      : www.freescale.com
;**     mail      : support@freescale.com
;** ###################################################################

 IFNDEF __DeviceInitialization_INC
__DeviceInitialization_INC: EQU  1

; Include shared modules, which are used for whole project 


; User declarations and definitions
;   Code, declarations and definitions here will be preserved during code generation
; End of user declarations and definitions

        XREF    MCU_init
;** ===================================================================
;**     Method      :  MCU_init (component MC9S08QE8_32)
;**
;**     Description :
;**         Device initialization code for selected peripherals.
;** ===================================================================



        XREF    isrVkeyboard
;** ===================================================================
;**     Interrupt handler : isrVkeyboard
;**
;**     Description :
;**         User interrupt service routine. 
;**     Parameters  : None
;**     Returns     : Nothing
;** ===================================================================



        XREF    isrVlvd
;** ===================================================================
;**     Interrupt handler : isrVlvd
;**
;**     Description :
;**         User interrupt service routine. 
;**     Parameters  : None
;**     Returns     : Nothing
;** ===================================================================






;      end     ; DeviceInitialization

 ENDIF   ; IFNDEF __DeviceInitialization_INC
;** ###################################################################
;**
;**     This file was created by Processor Expert 10.0 [05.03]
;**     for the Freescale HCS08 series of microcontrollers.
;**
;** ###################################################################
